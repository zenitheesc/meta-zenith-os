## conf/distro/zenithos.conf
```bitbake
include conf/distro/poky.conf

DISTRO = "zenithos"
DISTRO_NAME = "ZenithOS"
DISTRO_VERSION = "1.0.0"
DISTRO_CODENAME = "bap"
SDK_VENDOR = "-zenithossdk"
SDK_VERSION="${DISTRO_VERSION}"

MAINTAINER = "Zenith Aerospace <zenith.eesc@gmail.com>"

TARGET_VENDOR = "-zenithos"

ZENITH_DEFAULT_DISTRO_FEATURES = "systemd largefile ptest multiarch"
ZENITH_DEFAULT_USB = "usbhost usbgadget"
ZENITH_DEFAULT_DISTRO = "acl alsa argp ext2 ipv4 pcmcia xattr nfs zeroconf vfat ldconfig"
ZENITH_DEFAULT_EXTRA_RDEPENDS = "packagegroup-core-boot"
ZENITH_DEFAULT_EXTRA_RRECOMMENDS = "kernel-module-af-packet"

DISTRO_FEATURES ?= "${ZENITH_DEFAULT_DISTRO_FEATURES} ${ZENITH_DEFAULT_USB} ${ZENITH_DEFAULT_DISTRO}"

DISTRO_EXTRA_RDEPENDS += "${ZENITH_DEFAULT_EXTRA_RDEPENDS}"
DISTRO_EXTRA_RRECOMMENDS += "${ZENITH_DEFAULT_EXTRA_RRECOMMENDS}"

PREFERRED_VERSION_linux-yocto ?= "5.4%"

DISTRO_FEATURES_BACKFILL_CONSIDERED = "sysvinit"
VIRTUAL-RUNTIME_init_manager = "systemd"
VIRTUAL-RUNTIME_initscripts = ""

INIT_MANAGER ?= "systemd"
```

## conf/layer.conf
```bitbake
# We have a conf and classes directory, add to BBPATH
BBPATH .= ":${LAYERDIR}"

# We have recipes-* directories, add to BBFILES
BBFILES += "${LAYERDIR}/recipes-*/*/*.bb \
            ${LAYERDIR}/recipes-*/*/*.bbappend"

BBFILE_COLLECTIONS += "meta-zenith-os"
BBFILE_PATTERN_meta-zenith-os = "^${LAYERDIR}/"
BBFILE_PRIORITY_meta-zenith-os = "6"

LAYERDEPENDS_meta-zenith-os = "core"
LAYERSERIES_COMPAT_meta-zenith-os = "dunfell"
```
